## CMakeLists.txt
```
cmake_minimum_required(VERSION 3.20.0)
find_package(Zephyr REQUIRED HINTS $ENV{ZEPHYR_BASE})
project(GameOver)

# J_GL and J_ASSETS are compiled automatically by Zephyr's module system
# via modules/j_gl/zephyr/module.yml — no manual add_subdirectory needed.

zephyr_include_directories(src)

target_sources(app PRIVATE src/main.c)
target_sources(app PRIVATE src/j_controls.c)
target_sources(app PRIVATE src/j_assets.c)

add_subdirectory(games)
```

## west.yml
```
manifest:
  remotes:
    - name: zephyrproject-rtos
      url-base: https://github.com/zephyrproject-rtos
    - name: elitetq
      url-base: https://github.com/elitetq

  projects:
    - name: zephyr
      remote: zephyrproject-rtos
      revision: v4.2.0
      import:
        name-allowlist:
          - cmsis_6
          - hal_nordic

    - name: J-Graphics-Library
      remote: elitetq
      revision: main
      path: modules/j_gl

  self:
    path: app
```

## prj.conf
```kconfig
CONFIG_GPIO=y
CONFIG_PWM=y
CONFIG_SMF=y
CONFIG_SPI=y
CONFIG_SPI_ASYNC=y
CONFIG_I2C=y
CONFIG_ENTROPY_DEVICE_RANDOM_GENERATOR=y
CONFIG_TEST_RANDOM_GENERATOR=y
CONFIG_HEAP_MEM_POOL_SIZE=8192
# Required by J_GL internals
CONFIG_FPU=y
CONFIG_NEWLIB_LIBC=y
CONFIG_NEWLIB_LIBC_FLOAT_PRINTF=y
```

## src/main.c
```c
#include <zephyr/kernel.h>
#include <zephyr/kernel.h>
#include <zephyr/device.h>
#include <zephyr/drivers/spi.h>
#include <zephyr/drivers/gpio.h>
#include <zephyr/sys/printk.h>
#include <zephyr/random/random.h>
#include <zephyr/drivers/i2c.h>
#include <inttypes.h>
#include <stdbool.h>


#include <BTN.h>
#include <LED.h>

#include <j_assets.h>
#include <tots.h>
#include <j_controls.h>

#include <math.h>
#include <J_GL.h>
#include <J_ASSETS.h>

// LOW_HEIGHT - MAX_HEIGHT - LOW_LENGTH - MAX_LENGTH
uint16_t bounds[4] = {0x0000,LCD_MAX_HEIGHT,0x0000,LCD_MAX_LENGTH};

const struct gpio_dt_spec dcx_gpio = GPIO_DT_SPEC_GET(ZEPHYR_USER_NODE,dcx_gpios);
const struct spi_cs_control cs_ctrl = (struct spi_cs_control) {
  .gpio = GPIO_DT_SPEC_GET(ARDUINO_SPI_NODE,cs_gpios),
  .delay = 0u,
};

const struct device * dev = DEVICE_DT_GET(ARDUINO_SPI_NODE);
#define ARDUINO_I2C_NODE DT_NODELABEL(arduino_i2c)
const struct device * dev_i2c = DEVICE_DT_GET(ARDUINO_I2C_NODE);
const struct spi_config spi_cfg = {
  .frequency = 15000000,
  .operation = SPI_OP_MODE_MASTER | SPI_WORD_SET(8) | SPI_TRANSFER_MSB,
  .slave = 0,
  .cs = cs_ctrl
};

int main(void)
{
    if(0 > BTN_init())
      return 0;
    if(0 > LED_init())
      return 0;
    J_init(dev,dev_i2c,&spi_cfg,&dcx_gpio,bounds);
    J_LCD_init();



    uint16_t x,y;
    x = y = 0;

    j_color BG_FILL = BLACK;

    j_component* BLACK_FILL = create_component("black_bg_fill",J_FILL,0,0,(void*)&BG_FILL,NULL);
    draw_component(BLACK_FILL);

    tots_init();
    // draw_guy(5,5);
    
    while(1) {
      game_loop();
    }
    return 0;
}
```

## src/j_assets.c
```c
#include <j_assets.h>
```

## src/j_assets.h
```c
#ifndef MY_ASSETS_T
#define MY_ASSETS_T

#endif
```

## src/j_controls.c
```c
#include <j_controls.h>


int print_direction(swipe_dir dir) {
    switch(dir) {
        case J_SWIPE_DOWN: 
            printk("Swiped down!\n");
            break;
        case J_SWIPE_UP:
            printk("Swiped up!\n");
            break;
        case J_SWIPE_LEFT:
            printk("Swiped left!\n");
            break;
        case J_SWIPE_RIGHT: 
            printk("Swiped right!\n");
            break;
        default:
            break;
    }
    return 0;
}

swipe_dir get_swipe_touch_async(void) {
    static uint16_t sx = 0, sy = 0;
    static uint8_t cooldown = 0;
    static bool touching = false;

    uint16_t x, y;
    int dx, dy;

    poll_touch_timeout(&x,&y,SWIPE_SAMPLE_MS);
    if(x == 0xFFFF) {
        touching = false;
        return J_SWIPE_NONE;
    }

    if(cooldown) {
        cooldown--;
        return J_SWIPE_NONE;
    }

    if(!touching) {
        touching = true;
        sx = x;
        sy = y;
        return J_SWIPE_NONE; // return since dx and dy will always be 0
    }

    dx = (int)x - (int)sx; dy = (int)y - (int)sy;
    int xabs = abs(dx), yabs = abs(dy);

    if((xabs < SWIPE_MIN_DIST) && (yabs < SWIPE_MIN_DIST)) return J_SWIPE_NONE;

    cooldown = SWIPE_COOLDOWN;
    // Continuous dragging
    sx = x; 
    sy = y;
    
    if(xabs > yabs) return dx > 0 ? J_SWIPE_RIGHT : J_SWIPE_LEFT;
    return dy > 0 ? J_SWIPE_DOWN : J_SWIPE_UP;
}

// Records a finger drag and reports its dominant direction.
swipe_dir get_swipe_touch(int timeout) {
    uint16_t xs[SWIPE_MAX_SAMPLES];
    uint16_t ys[SWIPE_MAX_SAMPLES];
    int count = 0;
    uint16_t x, y;

    // polling touch initially
    poll_touch_timeout(&x, &y, timeout);
    if (x == 0xFFFF) {
        return J_SWIPE_NONE; // no touch within the timeout
    }
    xs[count] = x;
    ys[count] = y;
    count++;

    // sampling while finger is held down
    while (count < SWIPE_MAX_SAMPLES) {
        poll_touch_timeout(&x, &y, SWIPE_SAMPLE_MS);
        if (x == 0xFFFF) {
            break;
        }
        xs[count] = x;
        ys[count] = y;
        count++;
    }

    // net displacement
    int dx = (int)xs[count - 1] - (int)xs[0];
    int dy = (int)ys[count - 1] - (int)ys[0];

    // reject taps or tiny jitters
    if (abs(dx) < SWIPE_MIN_DIST && abs(dy) < SWIPE_MIN_DIST) {
        return J_SWIPE_NONE;
    }

    if (abs(dx) > abs(dy)) {
        return dx > 0 ? J_SWIPE_RIGHT : J_SWIPE_LEFT;
    }
    return dy > 0 ? J_SWIPE_DOWN : J_SWIPE_UP;
}
```

## src/j_controls.h
```c
#ifndef J_CONTROLS_T
#define J_CONTROLS_T

#include <J_GL.h>
#include <stdlib.h> // abs
#include <inttypes.h>
#include <inttypes.h>

#define SWIPE_MAX_SAMPLES 32 // most points recorded in a single swipe
#define SWIPE_SAMPLE_MS   1 // per-sample poll window while the finger is down
#define SWIPE_MIN_DIST    30 // min net travel (px) to count as a swipe vs a tap

#define SWIPE_COOLDOWN 2 // Cooldown (in game ticks) to wait for next swipe
#define Y_WEIGHT (float)0.8f // Weighting for the Y displacement, its easier to swipe in the y-dir than the x-dir. this makes swiping feel more accurate


// Try changing this and seeing if buggy
typedef enum {
    J_SWIPE_NONE = (uint8_t)0x00,
    J_SWIPE_RIGHT = (uint8_t)0x01,
    J_SWIPE_LEFT = (uint8_t)0x02,
    J_SWIPE_UP = (uint8_t)0x03,
    J_SWIPE_DOWN = (uint8_t)0x04
} swipe_dir;

swipe_dir get_swipe_touch(int timeout);

swipe_dir get_swipe_touch_async(void);

int print_direction(swipe_dir dir);

#endif
```
